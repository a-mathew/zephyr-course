## app/Kconfig
```kconfig
menuconfig LED_SUBSYSTEM
	bool "LED Subsystem"
	default y
	help
	  Enable the LED subsystem settings.

if LED_SUBSYSTEM

choice BLINK_SLEEP_TIME
	prompt "LED blink sleep time"
	default BLINK_SLEEP_TIME_1S

config BLINK_SLEEP_TIME_500MS
	bool "500ms (fast)"

config BLINK_SLEEP_TIME_1S
	bool "1s (medium)"

config BLINK_SLEEP_TIME_2S
	bool "2s (slow)"

endchoice

config BLINK_SLEEP_TIME_MS
	int
	default 500 if BLINK_SLEEP_TIME_500MS
	default 1000 if BLINK_SLEEP_TIME_1S
	default 2000 if BLINK_SLEEP_TIME_2S

menuconfig LED_ADVANCED
	bool "Advanced LED settings"
	help
	  Show advanced LED settings.

if LED_ADVANCED

config LED_BRIGHTNESS
	int "LED brightness (0-100)"
	range 0 100
	default 100

config LED_FADE_DURATION_MS
	int "LED fade duration (ms)"
	default 500

menu "Expert settings"

config LED_DEBUG
	bool "Enable LED debugging"

config LED_CUSTOM_PATTERN
	bool "Custom blink pattern"

endmenu

endif # LED_ADVANCED

endif # LED_SUBSYSTEM

source "Kconfig.zephyr"
```

## boards/custom2_wl55jc/board.yml
```yaml
board:
  name: custom2_wl55jc
  full_name: Custom2 WL55JC
  vendor: st
  socs:
    - name: stm32wl55xx
```

## boards/custom_wl55jc/board.yml
```yaml
board:
  name: custom_wl55jc
  full_name: Custom WL55JC
  vendor: st
  socs:
    - name: stm32wl55xx
```
